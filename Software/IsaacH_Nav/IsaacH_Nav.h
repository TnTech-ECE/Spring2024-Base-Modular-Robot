#include <Adafruit_Sensor_Calibration.h>
#include <Adafruit_AHRS.h>


#include <GyverOLED.h>
#include <QTRSensors.h>

//Objects
QTRSensors qtr;
Adafruit_Sensor *accelerometer, *gyroscope, *magnetometer;
GyverOLED<SSH1106_128x64> oled;
Adafruit_Mahony filter;

#include "LSM6DS_LIS3MDL.h"


//Pulls calibration data from EEPROM
#if defined(ADAFRUIT_SENSOR_CALIBRATION_USE_EEPROM)
  Adafruit_Sensor_Calibration_EEPROM cal;
#else
  Adafruit_Sensor_Calibration_SDFat cal;
#endif

#define FILTER_UPDATE_RATE_HZ 100
#define PRINT_EVERY_N_UPDATES 10
//#define AHRS_DEBUG_OUTPUT

uint32_t timestamp;
uint32_t u32_LineFollowingTime = 0;

//Line Following variables
const uint8_t SensorCount = 6;
uint16_t sensorValues[SensorCount];


void setup_LineFollowing();
void setup_Orientation();
void run_LineFollowing();
void run_OLED();
void run_Orientation();
void drawBattery(byte);
void charging();

struct Packet{
  uint16_t lineFollowing;
  float heading;
  float roll;
  float pitch;
  float qw;
  float qx;
  float qy; 
  float qz;
};

Packet packet;

//OLED variables
bool b_battery_charging = 1;
uint8_t voltage = 6;
uint8_t percent = 0;
const uint8_t techLogo [] PROGMEM = {
0x00, 0x00, 0x00, 0x00, 0x00, 0x00, 0x00, 0x00, 0x00, 0x00, 0x00, 0x00, 0x00, 0x00, 0x00, 0x00,
0x00, 0x00, 0x00, 0x00, 0x00, 0x00, 0x00, 0x00, 0x00, 0x00, 0x00, 0x00, 0x00, 0x00, 0x00, 0x00,
0x00, 0x00, 0x00, 0x00, 0x00, 0x00, 0x00, 0x00, 0x00, 0x00, 0x00, 0x00, 0x00, 0x00, 0x00, 0x00,
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0x00, 0x00, 0x00, 0x00, 0x00, 0x00, 0x00, 0x00, 0x00, 0x00, 0x00, 0x00, 0x00, 0x00, 0x00, 0x00
};

/*
*Function Name: setup_LineFollowing
*Parameters: None
*Returns: void
*Description: Initializes sensor pins and emitter pin. Calibrates the sensor for 10 seconds 
* to read the reflectance of the line and the background color. 
*/
void setup_LineFollowing(){
    // configure the sensors
  qtr.setTypeRC();
  qtr.setSensorPins((const uint8_t[]){52, 51, 50, 49, 48, 47}, SensorCount);
  qtr.setEmitterPin(53);

  delay(500);
  pinMode(LED_BUILTIN, OUTPUT);
  digitalWrite(LED_BUILTIN, HIGH); // turn on Arduino's LED to indicate we are in calibration mode

  // 2.5 ms RC read timeout (default) * 10 reads per calibrate() call
  // = ~25 ms per calibrate() call.
  // Call calibrate() 400 times to make calibration take about 10 seconds.
  for (uint16_t i = 0; i < 400; i++)
  {
    qtr.calibrate();
  }
  digitalWrite(LED_BUILTIN, LOW); // turn off Arduino's LED to indicate we are through with calibration

  // print the calibration minimum values measured when emitters were on
  /*for (uint8_t i = 0; i < SensorCount; i++)
  {
    Serial.print(qtr.calibrationOn.minimum[i]);
    Serial.print(' ');
  }
  Serial.println();*/
  
  // print the calibration maximum values measured when emitters were on
  /*for (uint8_t i = 0; i < SensorCount; i++)
  {
    Serial.print(qtr.calibrationOn.maximum[i]);
    Serial.print(' ');
  }
  Serial.println();
  Serial.println();*/
  delay(2000);
}

/*
*Function Name: setup_Orientation
*Parameters: None
*Returns: void
*Description: Calibrates the magnetometer and the accelerometer.
* Initializes the accelerometer, gyroscope, and magnetometer.
*/
void setup_Orientation(){
  if (!cal.begin()) {
    Serial.println("Failed to initialize calibration helper");
  }

  if (!init_sensors()) {
    Serial.println("Failed to find sensors");
    while (1) delay(10);
  }
  
  /*
  accelerometer->printSensorDetails();
  gyroscope->printSensorDetails();
  magnetometer->printSensorDetails();
  */

  setup_sensors();
  filter.begin(FILTER_UPDATE_RATE_HZ);
  timestamp = millis();

  Wire.setClock(400000); // 400KHz
}

void run_LineFollowing(){
  uint32_t u32_currentMillis = millis();
  if((u32_currentMillis - u32_LineFollowingTime)>=250){
    uint16_t position = qtr.readLineBlack(sensorValues);

    // print the sensor values as numbers from 0 to 1000, where 0 means maximum
    // reflectance and 1000 means minimum reflectance, followed by the line
    // position
    /*for (uint8_t i = 0; i < SensorCount; i++)
    {
      Serial.print(sensorValues[i]);
      Serial.print('\t');
    }*/
    packet.lineFollowing = position; 
  }
}

void run_OLED(){
  if(b_battery_charging){
    charging();
  }
  else{
    percent = voltage*100/12;
    oled.setCursorXY(0, 0);
    drawBattery(percent);
    oled.setCursorXY(20,0);

    oled.print(percent);
    oled.print("%");
    oled.drawBitmap(0, 0, techLogo, 128, 64);
    oled.update();
  }
}
void drawBattery(byte percent) {
  oled.drawByte(0b00111100);  // пипка
  oled.drawByte(0b00111100);
  oled.drawByte(0b11111111);  // стенка
  
  for (byte i = 0; i < 100 / 8; i++) {
    if (i < (100 - percent) / 8) oled.drawByte(0b10000001);
    else oled.drawByte(0b11111111);
  }
    oled.drawByte(0b11111111);  //Draw left part of battery
}

void charging(){
//Battery Fill Forward
  for (byte i = 0; i < 100; i += 5) {
    oled.clear();
    oled.setCursorXY(0, 0);
    drawBattery(i);
    oled.update();
    delay(50);
  }
  //Battery Fill Backward
  for (int i = 100; i > 0; i -= 5) {
    oled.clear();
    oled.setCursorXY(0, 0);
    drawBattery(i);
    oled.update();
    delay(50);
  }
}

void run_Orientation(){
  float roll, pitch, heading;
  float gx, gy, gz;
  static uint8_t counter = 0;

  if ((millis() - timestamp) < (1000 / FILTER_UPDATE_RATE_HZ)) {
    return;
  }
  timestamp = millis();
  // Read the motion sensors
  sensors_event_t accel, gyro, mag;
  accelerometer->getEvent(&accel);
  gyroscope->getEvent(&gyro);
  magnetometer->getEvent(&mag);


  cal.calibrate(mag);
  cal.calibrate(accel);
  cal.calibrate(gyro);
  // Gyroscope needs to be converted from Rad/s to Degree/s
  // the rest are not unit-important
  gx = gyro.gyro.x * SENSORS_RADS_TO_DPS;
  gy = gyro.gyro.y * SENSORS_RADS_TO_DPS;
  gz = gyro.gyro.z * SENSORS_RADS_TO_DPS;

  // Update the SensorFusion filter
  filter.update(gx, gy, gz, 
                accel.acceleration.x, accel.acceleration.y, accel.acceleration.z, 
                mag.magnetic.x, mag.magnetic.y, mag.magnetic.z);
/*#if defined(AHRS_DEBUG_OUTPUT)
  Serial.print("Update took "); Serial.print(millis()-timestamp); Serial.println(" ms");
#endif*/

  // only print the calculated output once in a while
  if (counter++ <= PRINT_EVERY_N_UPDATES) {
    return;
  }
  // reset the counter
  counter = 0;

/*#if defined(AHRS_DEBUG_OUTPUT)
  Serial.print("Raw: ");
  Serial.print(accel.acceleration.x, 4); Serial.print(", ");
  Serial.print(accel.acceleration.y, 4); Serial.print(", ");
  Serial.print(accel.acceleration.z, 4); Serial.print(", ");
  Serial.print(gx, 4); Serial.print(", ");
  Serial.print(gy, 4); Serial.print(", ");
  Serial.print(gz, 4); Serial.print(", ");
  Serial.print(mag.magnetic.x, 4); Serial.print(", ");
  Serial.print(mag.magnetic.y, 4); Serial.print(", ");
  Serial.print(mag.magnetic.z, 4); Serial.println("");
#endif
*/
  // print the heading, pitch and roll
  roll = filter.getRoll();
  pitch = filter.getPitch();
  heading = filter.getYaw();
  packet.heading = heading;
  packet.pitch = pitch;
  packet.roll = roll;
  /*Serial.print("Orientation: ");
  Serial.print(heading);
  Serial.print(", ");
  Serial.print(pitch);
  Serial.print(", ");
  Serial.println(roll);
*/
  float qw, qx, qy, qz;
  filter.getQuaternion(&qw, &qx, &qy, &qz);
  packet.qw = qw;
  //Serial.println(qw,4);
  packet.qx = qx;
  //Serial.println(qx,4);
  packet.qy = qy;
  //Serial.println(qy,4);
  packet.qz = qz;
  //Serial.println(qz,4);
  //Serial.println("Made it to the end");
  /*Serial.print("Quaternion: ");
  Serial.print(qw, 4);
  Serial.print(", ");
  Serial.print(qx, 4);
  Serial.print(", ");
  Serial.print(qy, 4);
  Serial.print(", ");
  Serial.println(qz, 4);  */
 /* 
#if defined(AHRS_DEBUG_OUTPUT)
  Serial.print("Took "); Serial.print(millis()-timestamp); Serial.println(" ms");
#endif*/
}

